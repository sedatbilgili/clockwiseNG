#include "StatusController.h"

#include <Locator.h>

#include "picopixel.h"
#include "../../clockfaces/cw-cf-0x01/gfx/assets.h"

#define ESP32_LED_BUILTIN 2

namespace
{
const uint8_t CW_STATUS_NTP[] PROGMEM = {
	0x00, 0x00, 0x00, 0x00, 0x00, 0x00, 0x00, 0x00, 0x3f, 0xff, 0xf0, 0x00, 0x40, 0x00, 0x08, 0x01,
	0x4b, 0x8e, 0xe8, 0x03, 0x58, 0xaa, 0xa8, 0x07, 0x4b, 0x8a, 0xa8, 0x67, 0x4a, 0x2a, 0xa8, 0xf7,
	0x4b, 0x8e, 0xe9, 0xff, 0x40, 0x00, 0x0b, 0xff, 0x3f, 0xff, 0xf3, 0xff, 0x00, 0x00, 0x03, 0xff,
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	0x00, 0x00, 0x00, 0x00, 0x00, 0x00, 0x00, 0x00, 0x00, 0x00, 0x00, 0x00, 0x00, 0x00, 0x00, 0x00
};

const uint8_t CW_STATUS_WIFI[] PROGMEM = {
	0x00, 0x00, 0x00, 0x00, 0x00, 0x00, 0x00, 0x00, 0x00, 0x00, 0x00, 0x00, 0x00, 0x00, 0x00, 0x00,
	0x00, 0x00, 0x00, 0x00, 0x00, 0x0f, 0xf0, 0x00, 0x00, 0xff, 0xff, 0x00, 0x03, 0xff, 0xff, 0xc0,
	0x0f, 0xff, 0xff, 0xf0, 0x1f, 0xff, 0xff, 0xf8, 0x7f, 0xf8, 0x1f, 0xfe, 0xff, 0xc0, 0x03, 0xff,
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	0x00, 0x00, 0x00, 0x00, 0x00, 0x00, 0x00, 0x00, 0x00, 0x00, 0x00, 0x00, 0x00, 0x00, 0x00, 0x00
};

const uint8_t CW_STATUS_DINO[] PROGMEM = {
	0x00, 0xff, 0xff, 0x00, 0x03, 0xf8, 0x1f, 0xc0, 0x07, 0xc0, 0x03, 0xe0, 0x0f, 0x00, 0x00, 0xf0,
	0x1e, 0x00, 0x00, 0x78, 0x3c, 0x00, 0x00, 0x3c, 0x78, 0x1f, 0xff, 0x9e, 0x70, 0x3f, 0xff, 0xee,
	0xe0, 0x33, 0xff, 0xe7, 0xe0, 0x73, 0xff, 0xe7, 0xc0, 0x7f, 0xff, 0xe3, 0xc0, 0x7f, 0xff, 0xe3,
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	0x0f, 0xfe, 0x00, 0xf0, 0x07, 0xfc, 0x03, 0xe0, 0x03, 0xfc, 0x1f, 0xc0, 0x00, 0xff, 0xff, 0x00
};

const uint16_t epd_bitmap_clockwise64[] PROGMEM = {
	0x0000, 0x0000, 0x0000, 0x0000, 0x0000, 0x0000, 0x0000, 0x0000, 0x0000, 0x0000, 0x0000, 0x0000, 0x0000, 0x0000, 0x0000, 0x0000,
	0x0000, 0x0000, 0x0000, 0x0000, 0x0000, 0x0000, 0x0000, 0x0000, 0x0000, 0x0000, 0x0000, 0x0000, 0x0000, 0x0000, 0x0000, 0x0000,
	0x0000, 0x0000, 0x0000, 0x0000, 0x0000, 0x0000, 0x0000, 0x0000, 0x0000, 0x0000, 0x0000, 0x0000, 0x0000, 0x0000, 0x0000, 0x0000,
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	0x0000, 0x0000, 0x0000, 0x0000, 0x0000, 0x0000, 0x0000, 0x0000, 0x0000, 0x0000, 0x0000};

} // namespace



StatusController *StatusController::getInstance()
{
	static StatusController base;
	return &base;
}

void StatusController::resetStatusPixelAnimation()
{
	_statusPixelLastStepMillis = 0;
	_statusPixelX = -1;
	_statusPixelColorIndex = 0;
}

void StatusController::animateStatusPixel(unsigned long now)
{
	if (_activeStatusScreen == StatusScreen::None)
	{
		return;
	}

	if (_statusPixelLastStepMillis != 0
		&& (now - _statusPixelLastStepMillis) < STATUS_PIXEL_STEP_INTERVAL_MS)
	{
		return;
	}

	_statusPixelLastStepMillis = now;

	if (_statusPixelX >= 0)
	{
		Locator::getDisplay()->drawPixel(_statusPixelX, STATUS_PIXEL_Y, 0x0000);
	}

	if (_statusPixelX < 0)
	{
		_statusPixelX = 0;
	}
	else
	{
		_statusPixelX++;
		if (_statusPixelX >= 64)
		{
			_statusPixelX = 0;
		}
	}

	static const uint16_t colors[] = {0xF800, 0x07E0, 0x001F};
	const uint16_t color = colors[_statusPixelColorIndex % 3];
	Locator::getDisplay()->drawPixel(_statusPixelX, STATUS_PIXEL_Y, color);
	_statusPixelColorIndex = (_statusPixelColorIndex + 1) % 3;
}

void StatusController::drawOtaIcon(uint8_t frameIndex)
{
	Locator::getDisplay()->fillRect(OTA_ICON_BOX_X, OTA_ICON_BOX_Y, OTA_ICON_BOX_SIZE, OTA_ICON_BOX_SIZE, 0x0000);
	const uint8_t rotation = frameIndex % 4;
	for (uint8_t y = 0; y < OTA_ICON_SIZE; ++y)
	{
		for (uint8_t x = 0; x < OTA_ICON_SIZE; ++x)
		{
			const uint16_t color = updateIcon[static_cast<size_t>(y) * OTA_ICON_SIZE + x];
			if (color == _MASK)
			{
				continue;
			}

			uint8_t drawX = x;
			uint8_t drawY = y;
			if (rotation == 1)
			{
				drawX = OTA_ICON_SIZE - 1 - y;
				drawY = x;
			}
			else if (rotation == 2)
			{
				drawX = OTA_ICON_SIZE - 1 - x;
				drawY = OTA_ICON_SIZE - 1 - y;
			}
			else if (rotation == 3)
			{
				drawX = y;
				drawY = OTA_ICON_SIZE - 1 - x;
			}

			Locator::getDisplay()->drawPixel(OTA_ICON_BOX_X + drawX, OTA_ICON_BOX_Y + drawY, color);
		}
	}
}

void StatusController::drawOtaProgressBar(uint8_t bucket)
{
	const uint8_t boundedBucket = min<uint8_t>(OTA_PROGRESS_BUCKETS, bucket);
	const uint8_t filledWidth = (boundedBucket * OTA_PROGRESS_BAR_WIDTH) / OTA_PROGRESS_BUCKETS;
	Locator::getDisplay()->drawRect(
		OTA_PROGRESS_BAR_X - 1,
		OTA_PROGRESS_BAR_Y - 1,
		OTA_PROGRESS_BAR_WIDTH + 2,
		OTA_PROGRESS_BAR_HEIGHT + 2,
		0x7BEF);
	Locator::getDisplay()->fillRect(
		OTA_PROGRESS_BAR_X,
		OTA_PROGRESS_BAR_Y,
		OTA_PROGRESS_BAR_WIDTH,
		OTA_PROGRESS_BAR_HEIGHT,
		0x2104);
	if (filledWidth > 0)
	{
		Locator::getDisplay()->fillRect(
			OTA_PROGRESS_BAR_X,
			OTA_PROGRESS_BAR_Y,
			filledWidth,
			OTA_PROGRESS_BAR_HEIGHT,
			0x07E0);
	}
}

void StatusController::clockwiseLogo()
{
	_activeStatusScreen = StatusScreen::None;
	resetStatusPixelAnimation();
	Locator::getDisplay()->drawRGBBitmap(1, 1, epd_bitmap_clockwise64, 63, 21);
}

void StatusController::wifiConnecting()
{
	if (_activeStatusScreen != StatusScreen::WiFiConnecting)
	{
		resetStatusPixelAnimation();
	}
	_activeStatusScreen = StatusScreen::WiFiConnecting;
	Locator::getDisplay()->fillRect(0, 24, 64, 52, 0);
	Locator::getDisplay()->drawBitmap(16, 21, CW_STATUS_WIFI, 32, 32, 0x2459);
	printCenter("WiFi Baglaniyor", 58);
}

void StatusController::wifiConnectionFailed(const char *msg)
{
	if (_activeStatusScreen != StatusScreen::WiFiFailed)
	{
		resetStatusPixelAnimation();
	}
	_activeStatusScreen = StatusScreen::WiFiFailed;
	Locator::getDisplay()->fillRect(0, 24, 64, 52, 0);
	Locator::getDisplay()->drawBitmap(16, 21, CW_STATUS_WIFI, 32, 32, 0xFA28);
	printCenter(msg, 58);
}

void StatusController::ntpConnecting()
{
	if (_activeStatusScreen != StatusScreen::NtpConnecting)
	{
		resetStatusPixelAnimation();
	}
	_activeStatusScreen = StatusScreen::NtpConnecting;
	Locator::getDisplay()->fillRect(0, 24, 64, 52, 0);
	Locator::getDisplay()->drawBitmap(16, 21, CW_STATUS_NTP, 32, 32, 0xBCBF);
	printCenter("NTP Sunucu", 58);
}

void StatusController::otaUpdating(uint8_t progress)
{
	const uint8_t bucket = min<uint8_t>(OTA_PROGRESS_BUCKETS, progress / 2);
	if (_lastOtaProgress == bucket)
	{
		return;
	}

	if (_lastOtaProgress == 255)
	{
		_activeStatusScreen = StatusScreen::None;
		resetStatusPixelAnimation();
		Locator::getDisplay()->fillScreen(0x0000);
		printCenter("GUNCELLENIYOR", 42);
	}

	drawOtaIcon(bucket);
	drawOtaProgressBar(bucket);
	_lastOtaProgress = bucket;
}

void StatusController::resetOtaUi()
{
	_lastOtaProgress = 255;
	_lastOtaRenderMillis = 0;
}

void StatusController::printCenter(const char *buf, int y)
{
	int16_t x1, y1;
	uint16_t w, h;
	Locator::getDisplay()->setFont(&Picopixel);
	Locator::getDisplay()->getTextBounds(buf, 0, y, &x1, &y1, &w, &h);
	Locator::getDisplay()->setCursor(32 - (w / 2), y);
	Locator::getDisplay()->setTextColor(0xffff);
	Locator::getDisplay()->print(buf);
}

void StatusController::blink_led(int d, int times)
{
	this->_ledBlinkActive = times > 0;
	this->_ledStateHigh = false;
	this->_ledBlinkIntervalMillis = d > 0 ? static_cast<unsigned long>(d) : 1UL;
	this->_ledLastToggleMillis = millis();
	this->_ledRemainingTransitions = times * 2;
	digitalWrite(ESP32_LED_BUILTIN, LOW);
}

void StatusController::forceRestart()
{
	if (this->_restartScheduled)
	{
		return;
	}

	this->_restartScheduled = true;
	this->_restartAtMillis = millis() + 1000UL;
}

void StatusController::clearStatusAnimation()
{
	if (_statusPixelX >= 0)
	{
		Locator::getDisplay()->drawPixel(_statusPixelX, STATUS_PIXEL_Y, 0x0000);
	}
	_activeStatusScreen = StatusScreen::None;
	resetStatusPixelAnimation();
}

void StatusController::process()
{
	unsigned long now = millis();
	animateStatusPixel(now);

	if (this->_ledBlinkActive && this->_ledRemainingTransitions > 0 && now - this->_ledLastToggleMillis >= this->_ledBlinkIntervalMillis)
	{
		this->_ledLastToggleMillis = now;
		this->_ledStateHigh = !this->_ledStateHigh;
		digitalWrite(ESP32_LED_BUILTIN, this->_ledStateHigh ? HIGH : LOW);
		this->_ledRemainingTransitions--;
		if (this->_ledRemainingTransitions == 0)
		{
			this->_ledBlinkActive = false;
			this->_ledStateHigh = false;
			digitalWrite(ESP32_LED_BUILTIN, LOW);
		}
	}

	if (this->_restartScheduled && now >= this->_restartAtMillis)
	{
		this->_restartScheduled = false;
		ESP.restart();
	}
}
